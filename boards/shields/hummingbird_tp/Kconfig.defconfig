## boards/shields/hummingbird_tp/Kconfig.defconfig
```kconfig
# Copyright (c) 2022 The ZMK Contributors
# SPDX-License-Identifier: MIT

if SHIELD_HUMMINGBIRD_TP

config ZMK_KEYBOARD_NAME
    default "Hummingbird TP"

endif
```
